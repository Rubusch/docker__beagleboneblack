## docker__yocto/meta-lothars-configs/conf/bblayers.conf.sample
```bitbake
# POKY_BBLAYERS_CONF_VERSION is increased each time build/conf/bblayers.conf
# changes incompatibly
POKY_BBLAYERS_CONF_VERSION = "2"

BBPATH = "${TOPDIR}"
BBFILES ?= ""

BBLAYERS ?= " \
  ~/poky/meta \
  ~/poky/meta-poky \
  ~/poky/meta-yocto-bsp \
  "

## currently turned off, needed for e.g. application
#  ~/poky/meta-lothars-configs
```
